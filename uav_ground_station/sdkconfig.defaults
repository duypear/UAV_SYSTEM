## uav_ground_station/sdkconfig.defaults
```kconfig
# Target ESP32-C3
CONFIG_IDF_TARGET="esp32c3"

# CPU Clock 160MHz
CONFIG_ESP32C3_DEFAULT_CPU_FREQ_160=y
CONFIG_ESP32C3_DEFAULT_CPU_FREQ_MHZ=160

# FreeRTOS 1000Hz tick rate for smooth telemetry and web server
CONFIG_FREERTOS_HZ=1000

# HTTP Server configuration
CONFIG_HTTPD_MAX_REQ_HDR_LEN=1024
CONFIG_HTTPD_MAX_URI_LEN=512
CONFIG_HTTPD_ERR_RESP_NO_DELAY=y

# Compiler optimization for performance
CONFIG_COMPILER_OPTIMIZATION_PERF=y

# Log output
CONFIG_LOG_DEFAULT_LEVEL_INFO=y
```
